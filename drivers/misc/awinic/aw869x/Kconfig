## drivers/misc/awinic/aw869x/Kconfig
```kconfig
#
# AW8695 Driver
#

config AW869x_HAPTIC
	tristate "Awinic AW869x haptic driver"
	depends on I2C && INPUT_AWINIC_HAPTIC
	help
	  Say Y here if you have Awinic AW8695 haptic controller
	  chip in your system.

	  If unsure, say N.

	  To compile this driver as a module, choose M here: the
	  module will be called aw869x.
```
